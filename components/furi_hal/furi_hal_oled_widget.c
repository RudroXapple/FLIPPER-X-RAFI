#include "furi_hal_oled_widget.h"
#include <string.h>

#define OLED_W 128
#define OLED_H 64
#define OLED_SIZE (OLED_W * OLED_H / 8)

/* 5x7 font — ASCII 32-126 */
static const uint8_t font5x7[][5] = {
    {0x00,0x00,0x00,0x00,0x00}, /* space */
    {0x00,0x00,0x5F,0x00,0x00}, /* ! */
    {0x00,0x07,0x00,0x07,0x00}, /* " */
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    {0x08,0x08,0x2A,0x1C,0x08}, /* ~ */
};

static uint8_t oled_fb[OLED_SIZE];
static OledMode current_mode = OledModeMirror;

extern void furi_hal_oled_commit(const uint8_t* data, uint32_t size);

void furi_hal_oled_set_mode(OledMode mode) {
    current_mode = mode;
}

OledMode furi_hal_oled_get_mode(void) {
    return current_mode;
}

void oled_widget_clear(void) {
    memset(oled_fb, 0, sizeof(oled_fb));
}

static void oled_set_pixel(int x, int y) {
    if(x < 0 || x >= OLED_W || y < 0 || y >= OLED_H) return;
    oled_fb[(y / 8) * OLED_W + x] |= (1 << (y % 8));
}

static void oled_clear_pixel(int x, int y) {
    if(x < 0 || x >= OLED_W || y < 0 || y >= OLED_H) return;
    oled_fb[(y / 8) * OLED_W + x] &= ~(1 << (y % 8));
}

void oled_widget_draw_str(int x, int y, const char* str) {
    if(!str) return;
    while(*str) {
        char c = *str;
        if(c < 32 || c > 126) c = '?';
        const uint8_t* glyph = font5x7[c - 32];
        for(int i = 0; i < 5; i++) {
            uint8_t col = glyph[i];
            for(int j = 0; j < 7; j++) {
                if(col & (1 << j)) oled_set_pixel(x + i, y + j);
            }
        }
        x += 6;
        str++;
        if(x + 6 > OLED_W) break;
    }
}

void oled_widget_draw_str_big(int x, int y, const char* str) {
    /* 2x scaled text */
    if(!str) return;
    while(*str) {
        char c = *str;
        if(c < 32 || c > 126) c = '?';
        const uint8_t* glyph = font5x7[c - 32];
        for(int i = 0; i < 5; i++) {
            uint8_t col = glyph[i];
            for(int j = 0; j < 7; j++) {
                if(col & (1 << j)) {
                    oled_set_pixel(x + i*2, y + j*2);
                    oled_set_pixel(x + i*2 + 1, y + j*2);
                    oled_set_pixel(x + i*2, y + j*2 + 1);
                    oled_set_pixel(x + i*2 + 1, y + j*2 + 1);
                }
            }
        }
        x += 12;
        str++;
        if(x + 12 > OLED_W) break;
    }
}

void oled_widget_draw_hline(int x, int y, int w) {
    for(int i = 0; i < w; i++) oled_set_pixel(x + i, y);
}

void oled_widget_draw_vline(int x, int y, int h) {
    for(int i = 0; i < h; i++) oled_set_pixel(x, y + i);
}

void oled_widget_draw_rect(int x, int y, int w, int h, bool fill) {
    if(fill) {
        for(int j = 0; j < h; j++)
            for(int i = 0; i < w; i++)
                oled_set_pixel(x + i, y + j);
    } else {
        oled_widget_draw_hline(x, y, w);
        oled_widget_draw_hline(x, y + h - 1, w);
        oled_widget_draw_vline(x, y, h);
        oled_widget_draw_vline(x + w - 1, y, h);
    }
}

void oled_widget_draw_bar(int x, int y, int w, int h, uint8_t pct) {
    oled_widget_draw_rect(x, y, w, h, false);
    if(pct > 100) pct = 100;
    int fill_w = (w - 2) * pct / 100;
    for(int j = 1; j < h - 1; j++)
        for(int i = 1; i <= fill_w; i++)
            oled_set_pixel(x + i, y + j);
}

void oled_widget_draw_icon(int x, int y, const uint8_t* icon_1bpp, int icon_w, int icon_h) {
    if(!icon_1bpp) return;
    int stride = (icon_w + 7) / 8;
    for(int j = 0; j < icon_h; j++) {
        for(int i = 0; i < icon_w; i++) {
            if(icon_1bpp[j * stride + i / 8] & (0x80 >> (i % 8)))
                oled_set_pixel(x + i, y + j);
        }
    }
}

void oled_widget_commit(void) {
    furi_hal_oled_commit(oled_fb, sizeof(oled_fb));
}
